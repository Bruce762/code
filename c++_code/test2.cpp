#include <stdio.h>
#include "NUC100Series.h"
#include "MCU_init.h"
#include "SYS_init.h"
#include "LCD.h"
#include "Scankey.h"
#define SIZE 64
//#define int int8_t

int tmpInt,Intk;
bool matrix[64][64] = {0};


void EINT1_IRQHandler(void)
{
    GPIO_CLR_INT_FLAG(PB, BIT15);	// Clear GPIO interrupt flag
    Intk=1;
}

void Init_EXTINT(void)
{
    // Configure EINT1 pin and enable interrupt by rising and falling edge trigger
    GPIO_SetMode(PB, BIT15, GPIO_MODE_INPUT);
    GPIO_EnableEINT1(PB, 15, GPIO_INT_RISING); // RISING, FALLING, BOTH_EDGE, HIGH, LOW
    NVIC_EnableIRQ(EINT1_IRQn);

    // Enable interrupt de-bounce function and select de-bounce sampling cycle time
    GPIO_SET_DEBOUNCE_TIME(GPIO_DBCLKSRC_LIRC, GPIO_DBCLKSEL_64);
    GPIO_ENABLE_DEBOUNCE(PB, BIT15);
}
/*
123 
456
789

369
258
157
*/

unsigned char picture1[64*8] = { // TCFST Logo 
        0x00,0x00,0x00,0x00,0xC0,0x30,0x08,0x04,0x02,0x02,0x01,0x01,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0x00
	, 	0x00,0x00,0x00,0x00,0xFF,0x00,0x00,0x00,0x00,0x00,0x00,0x00,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0x00
	, 	0x00,0x00,0x00,0x00,0x03,0x1E,0x70,0x80,0x00,0xF0,0x08,0x00,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0x00
	, 	0x00,0x00,0x00,0x00,0x00,0x00,0x00,0x01,0xFF,0x00,0x00,0x00,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0x00
	, 	0x00,0x00,0x00,0x00,0x00,0x00,0x00,0x00,0x01,0x0E,0x30,0xC0,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0x00
	, 	0x00,0x00,0x00,0x00,0x00,0x00,0x00,0x00,0x00,0x00,0x00,0x00,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0x00
	, 	0x00,0x00,0x00,0x00,0x00,0x00,0x00,0x00,0x00,0x00,0x00,0x00,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0x00
	, 	0x00,0x00,0x00,0x00,0x00,0x00,0x00,0x00,0x00,0x00,0x00,0x00,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0x00
};

unsigned char picture2[64*8] = { // TCFST Logo 
        0x00,0x00,0x00,0x00,0xC0,0x30,0x08,0x04,0x02,0x02,0x01,0x01,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0x00
	, 	0x00,0x00,0x00,0x00,0xFF,0x00,0x00,0x00,0x00,0x00,0x00,0x00,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0x00
	, 	0x00,0x00,0x00,0x00,0x03,0x1E,0x70,0x80,0x00,0xF0,0x08,0x00,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0x00
	, 	0x00,0x00,0x00,0x00,0x00,0x00,0x00,0x01,0xFF,0x00,0x00,0x00,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0x00
	, 	0x00,0x00,0x00,0x00,0x00,0x00,0x00,0x00,0x01,0x0E,0x30,0xC0,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0x00
	, 	0x00,0x00,0x00,0x00,0x00,0x00,0x00,0x00,0x00,0x00,0x00,0x00,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0x00
	, 	0x00,0x00,0x00,0x00,0x00,0x00,0x00,0x00,0x00,0x00,0x00,0x00,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0x00
	, 	0x00,0x00,0x00,0x00,0x00,0x00,0x00,0x00,0x00,0x00,0x00,0x00,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0x00
};

unsigned char using_picture[64*8];

void swap(bool* a,bool* b){
    bool tmp = *a;
    *a = *b;
    *b = tmp;
}

void Flip_vertically(int row,int col,bool* matrix){
    int i,j;
    for(i=0;i<row/2;i++){
        for(j=0;j<col;j++){
            swap( ( matrix + i * col + j ) , ( matrix + ( row - 1 -i) * col + j ));
        }
    }
}

void Flip_horizontally(int row,int col,bool* matrix){
    int i,j;
    for(i=0;i<row;i++){
        for(j=0;j<col/2;j++){
            swap( ( matrix + i * col + j ) , ( matrix + i * col + (col - 1 - j )) );
        }
    }
}

void Rotate_90_clockwise(int row,int col,bool* matrix){
    int i,j,tmp[10000];
    for(i=0;i<row;i++){
        for(j=0;j<col;j++){  
            *(tmp + (row-1-j)*row + i)=*(matrix + i*row + j);
        }
    }
    for(i=0;i<row;i++){
        for(j=0;j<col;j++){  
            *(matrix + i*row + j)=*(tmp + i*row + j);
        }
    }
}

void Rotate_90_counterclockwise(int row,int col,bool* matrix){
    int i,j,tmp[10000];
    for(i=0;i<row;i++){
        for(j=0;j<col;j++){  
            *(tmp + j*row + (col-1-i))=*(matrix + i*row + j);
        }
    }
    for(i=0;i<row;i++){
        for(j=0;j<col;j++){  
            *(matrix + i*row + j)=*(tmp + i*row + j);
        }
    }
}

void hexToBinaryMatrix(unsigned char* BMP_Logo_TCFST, bool matrix[64][64]) {
	int i ,j ,k;
	
    for( i = 0; i < 8; i++) {
        for( j = 0; j < 64; j++) {
            for( k = 0; k < 8; k++) {
                matrix[i * 8 + k][j] = (BMP_Logo_TCFST[i * 64 + j] >> k) & 1;
            }        
        }
    }
}

void binaryMatrixToHex(bool matrix[64][64], unsigned char* BMP_Logo_TCFST) {
	int i , j,k;
	unsigned char tmp;
    for( i = 0; i < 8; i++) {
        for( j = 0; j < 64; j++) {
            tmp = 0;
            for(k = 0; k <8 ; k++) { 
                tmp = (tmp << 1) | matrix[i * 8 + (7 - k)][j];
            }
            BMP_Logo_TCFST[i * 64 + j] = tmp;
        }
    }
}

void reset(unsigned char* p1,unsigned char* p2){
    int i,j;
    for(i=0;i<8;i++){
        for(j=0;j<64;j++){
            *(p2+i*64+j)=*(p1+i*64+j);
        }
    }
}

void debug(){
	PC13=0;
	CLK_SysTickDelay(50000);
	PC13=1;
}

signed main(void)
{
	int i,j,k,tmpK,num,pflag=1;//pflag=1時是picture1 pflag=0是picture2
	
	SYS_Init();
	Init_EXTINT();
	init_LCD();
	clear_LCD();
	OpenKeyPad();	              // initialize 3x3 keypad
    reset(picture1,using_picture);
	draw_Bmp64x64(31,0,FG_COLOR,BG_COLOR,using_picture);
	while(1){
        k=ScanKey();
        CLK_SysTickDelay(50000);
        if ((k != tmpK && k !=0) || (Intk != tmpInt && Intk !=0)){
            if(Intk)num=0;
            else num=k;
            hexToBinaryMatrix(using_picture,matrix);
            if(num==2){
                Flip_vertically(SIZE,SIZE,&matrix[0][0]);//SIZE可能出錯
            }else if(num==4){
                Flip_horizontally(SIZE,SIZE,&matrix[0][0]);
            }else if(num==5){
                pflag=(pflag+1)%2;
                //切換
                if(pflag==1){
                    reset(picture1,using_picture);
                }else{
                    reset(picture2,using_picture);
                }
                hexToBinaryMatrix(using_picture,matrix);
            }else if(num==6){
                Rotate_90_clockwise(SIZE,SIZE,&matrix[0][0]);
            }else if(num==8){
                Rotate_90_counterclockwise(SIZE,SIZE,&matrix[0][0]);
            }if(num==0){
                //重置
                if(pflag==1){
                    reset(picture1,using_picture);
                }else{
                    reset(picture2,using_picture);
                }
                hexToBinaryMatrix(using_picture,matrix);
            }
            binaryMatrixToHex(matrix,using_picture);
            draw_Bmp64x64(31,0,FG_COLOR,BG_COLOR,using_picture);
        }
        tmpK=k;
        tmpInt=Intk;
        Intk=0;
    }
	return 0;
}
